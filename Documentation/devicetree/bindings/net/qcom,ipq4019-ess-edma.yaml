## Documentation/devicetree/bindings/net/qcom,ipq4019-ess-edma.yaml
```yaml
# SPDX-License-Identifier: (GPL-2.0-only OR BSD-2-Clause)
%YAML 1.2
---
$id: http://devicetree.org/schemas/net/qcom,ipq4019-ess-edma.yaml#
$schema: http://devicetree.org/meta-schemas/core.yaml#

title: Qualcomm IPQ ESS EDMA Ethernet Controller

maintainers:
  - Maxime Chevallier <maxime.chevallier@bootlin.com>

allOf:
  - $ref: ethernet-controller.yaml#

properties:
  compatible:
    const: qcom,ipq4019-ess-edma

  reg:
    maxItems: 1

  interrupts:
    maxItems: 32
    description: One interrupt per tx and rx queue, the first 16 are rx queues
                 and the last 16 are the tx queues

  clocks:
    maxItems: 1

  resets:
    maxItems: 1

required:
  - compatible
  - reg
  - interrupts
  - clocks
  - resets
  - phy-mode

unevaluatedProperties: false

examples:
  - |
    #include <dt-bindings/clock/qcom,gcc-ipq4019.h>
    #include <dt-bindings/interrupt-controller/arm-gic.h>
    #include <dt-bindings/interrupt-controller/irq.h>
    gmac: ethernet@c080000 {
        compatible = "qcom,ipq4019-ess-edma";
        reg = <0xc080000 0x8000>;
        resets = <&gcc ESS_RESET>;
        clocks = <&gcc GCC_ESS_CLK>;
        interrupts = <GIC_SPI  65 IRQ_TYPE_EDGE_RISING>,
                     <GIC_SPI  66 IRQ_TYPE_EDGE_RISING>,
                     <GIC_SPI  67 IRQ_TYPE_EDGE_RISING>,
                     <GIC_SPI  68 IRQ_TYPE_EDGE_RISING>,
                     <GIC_SPI  69 IRQ_TYPE_EDGE_RISING>,
                     <GIC_SPI  70 IRQ_TYPE_EDGE_RISING>,
                     <GIC_SPI  71 IRQ_TYPE_EDGE_RISING>,
                     <GIC_SPI  72 IRQ_TYPE_EDGE_RISING>,
                     <GIC_SPI  73 IRQ_TYPE_EDGE_RISING>,
                     <GIC_SPI  74 IRQ_TYPE_EDGE_RISING>,
                     <GIC_SPI  75 IRQ_TYPE_EDGE_RISING>,
                     <GIC_SPI  76 IRQ_TYPE_EDGE_RISING>,
                     <GIC_SPI  77 IRQ_TYPE_EDGE_RISING>,
                     <GIC_SPI  78 IRQ_TYPE_EDGE_RISING>,
                     <GIC_SPI  79 IRQ_TYPE_EDGE_RISING>,
                     <GIC_SPI  80 IRQ_TYPE_EDGE_RISING>,
                     <GIC_SPI 240 IRQ_TYPE_EDGE_RISING>,
                     <GIC_SPI 241 IRQ_TYPE_EDGE_RISING>,
                     <GIC_SPI 242 IRQ_TYPE_EDGE_RISING>,
                     <GIC_SPI 243 IRQ_TYPE_EDGE_RISING>,
                     <GIC_SPI 244 IRQ_TYPE_EDGE_RISING>,
                     <GIC_SPI 245 IRQ_TYPE_EDGE_RISING>,
                     <GIC_SPI 246 IRQ_TYPE_EDGE_RISING>,
                     <GIC_SPI 247 IRQ_TYPE_EDGE_RISING>,
                     <GIC_SPI 248 IRQ_TYPE_EDGE_RISING>,
                     <GIC_SPI 249 IRQ_TYPE_EDGE_RISING>,
                     <GIC_SPI 250 IRQ_TYPE_EDGE_RISING>,
                     <GIC_SPI 251 IRQ_TYPE_EDGE_RISING>,
                     <GIC_SPI 252 IRQ_TYPE_EDGE_RISING>,
                     <GIC_SPI 253 IRQ_TYPE_EDGE_RISING>,
                     <GIC_SPI 254 IRQ_TYPE_EDGE_RISING>,
                     <GIC_SPI 255 IRQ_TYPE_EDGE_RISING>;

        phy-mode = "internal";
        fixed-link {
            speed = <1000>;
            full-duplex;
            pause;
        };
    };

...
```

## Documentation/devicetree/bindings/net/qcom,ipq4019-ess-switch.yaml
```yaml
# SPDX-License-Identifier: (GPL-2.0-only OR BSD-2-Clause)
%YAML 1.2
---
$id: http://devicetree.org/schemas/net/qcom,ipq4019-ess-switch.yaml#
$schema: http://devicetree.org/meta-schemas/core.yaml#

title: Qualcomm IPQ ESS built-in switch driver

maintainers:
  - Romain Gantois <romain.gantois@bootlin.com>

$ref: ethernet-switch.yaml#

properties:
  compatible:
    const: qca,ipq4019-qca8337n

  reg:
    maxItems: 2
    description: One reg for base registers and one for psgmii_phy registers

  reg-names:
    maxItems: 2

  psgmii-ethphy:
    maxItems: 1
    description: Handle to the MDIO bus node corresponding to the PSGMII

  resets:
    maxItems: 1

  reset-names:
    maxItems: 1

  mdio:
    maxItems: 1
    description: Handle to the IPQ4019 MDIO Controller

required:
  - compatible
  - reg
  - reg-names
  - resets
  - mdio

unevaluatedProperties: false

examples:
  - |
    #include <dt-bindings/net/qcom-qca807x.h>
    switch: switch@c000000 {
         compatible = "qca,ipq4019-qca8337n";
         reg = <0xc000000 0x80000>, <0x98000 0x800>;
         reg-names = "base", "psgmii_phy";
         resets = <&gcc ESS_PSGMII_ARES>;
         mdio = <&mdio>;
         psgmii-ethphy = <&psgmiiphy>;

         ports {
             #address-cells = <1>;
             #size-cells = <0>;

             swport1: port@1 { /* MAC1 */
                  reg = <1>;
                  label = "lan1";
                  phy-handle = <&ethphy0>;
                  phy-mode = "psgmii";
             };

             swport2: port@2 { /* MAC2 */
                  reg = <2>;
                  label = "lan2";
                  phy-handle = <&ethphy1>;
                  phy-mode = "psgmii";
             };

             swport3: port@3 { /* MAC3 */
                  reg = <3>;
                  label = "lan3";
                  phy-handle = <&ethphy2>;
                  phy-mode = "psgmii";
             };

             swport4: port@4 { /* MAC4 */
                  reg = <4>;
                  label = "lan4";
                  phy-handle = <&ethphy3>;
                  phy-mode = "psgmii";
             };

             swport5: port@5 { /* MAC5 */
                  reg = <5>;
                  label = "wan";
                  phy-handle = <&ethphy4>;
                  phy-mode = "psgmii";
             };
         };
    };

...
```

## net/dsa/Kconfig
```kconfig
# SPDX-License-Identifier: GPL-2.0-only

menuconfig NET_DSA
	tristate "Distributed Switch Architecture"
	depends on BRIDGE || BRIDGE=n
	depends on HSR || HSR=n
	depends on INET && NETDEVICES
	select GRO_CELLS
	select NET_SWITCHDEV
	select PHYLINK
	select NET_DEVLINK
	imply NET_SELFTESTS
	select SKB_EXTENSIONS
	help
	  Say Y if you want to enable support for the hardware switches supported
	  by the Distributed Switch Architecture.
```
